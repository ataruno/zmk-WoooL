## boards/shields/MoooseMiniCP/Kconfig.defconfig
```kconfig
if SHIELD_MoooseMiniCP

config ZMK_KEYBOARD_NAME
    default "MoooseMiniCP"

endif
```

## config/boards/shields/MoooseBT/Kconfig.defconfig
```kconfig
if SHIELD_MoooseBT_RIGHT

config ZMK_KEYBOARD_NAME
    default "MoooseBT"

config ZMK_SPLIT_ROLE_CENTRAL
    default y

endif

if SHIELD_MoooseBT_LEFT || SHIELD_MoooseBT_RIGHT

config ZMK_SPLIT
    default y

endif
```

## config/boards/shields/MoooseBT/Kconfig.shield
```kconfig
# Copyright (c) 2022 The ZMK Contributors
# SPDX-License-Identifier: MIT

config SHIELD_MoooseBT_LEFT
    def_bool $(shields_list_contains,MoooseBT_left)

config SHIELD_MoooseBT_RIGHT
    def_bool $(shields_list_contains,MoooseBT_right)
```

## config/west.yml
```yaml
manifest:
  remotes:
    - name: zmkfirmware
      url-base: https://github.com/zmkfirmware
    - name: ataruno-git
      url-base: https://github.com/ataruno
  projects:
    - name: zmk
      remote: zmkfirmware
      revision: v0.3-branch
      import: app/west.yml
    - name: zmk-rgbled-widget
      remote: ataruno-git
      revision: main
  self:
    path: config
```
